const PROGMEM unsigned char letters[45][8] = {
  {0x3C, 0x42, 0x42, 0x42, 0x42, 0x42, 0x42, 0x3C}, //0
  {0x8, 0x18, 0x28, 0x8, 0x8, 0x8, 0x8, 0x8}, //1
  {0x7E, 0x2, 0x2, 0x7E, 0x40, 0x40, 0x40, 0x7E}, //2
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  {0x3E, 0x22, 0x22, 0x3E, 0x2, 0x2, 0x2, 0x3E}, //9
  {},
  {},
  {},
  {},
  {0x0, 0x0, 0x0, 0x0, 0x0, 0x0, 0x0, 0x0}, //SPACE
  {},
  {},
  {0x8, 0x14, 0x22, 0x3E, 0x22, 0x22, 0x22, 0x22}, //A
  {0x7c, 0x42, 0x42, 0x7e, 0x42, 0x42, 0x42, 0x7c}, //B
  {0x3e, 0x40, 0x40, 0x40, 0x40, 0x40, 0x40, 0x3e}, //C
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  {0x7e, 0x02, 0x04, 0x08, 0x10, 0x20, 0x40, 0x7e}, //Z
};
void convertCharToBool(unsigned char c, bool b[8])
{
  for (int i = 0; i < 8; ++i) {
    b[i] = (c & (1 << i)) != 0;
  }
}
static int x = 0;
static int frame = 0;
const PROGMEM char string_0[] = " IT EVENT 2017";   // "String 0" etc are strings to store - change to suit.
const PROGMEM char string_1[] = " LOUIS RIEL";
const PROGMEM char string_2[] = " TRANSPORTATION";
const PROGMEM char string_3[] = " COPERNICUS";
const PROGMEM char string_4[] = " ALLEN AND WRIGHTS";
const PROGMEM char string_5[] = " VAFGEHZRAG";
const PROGMEM char string_6[] = " ZREPHEL";
const PROGMEM char string_7[] = " 271";
const PROGMEM char string_8[] = " SVFU";
const PROGMEM char string_9[] = " ABORY";
const PROGMEM char string_10[] = " NTEVPHYGHER";
const PROGMEM char string_11[] = " FCVAXF";
const PROGMEM char string_12[] = " PELVAT JBYS";

PGM_P const string_table[] PROGMEM =
{   
  string_0,
  string_1,
  string_2,
  string_3,
  string_4,
  string_5,
  string_6,
  string_7,
  string_8,
  string_9,
  string_10,
  string_11,
  string_12
};

void mode_scavenger(uint8_t action) {
  char message[36];
  strcpy_P(message, (char*)pgm_read_word(&(string_table[messageIndex])));
  int messageBits = strlen(message) * 8;
  int messageLen = strlen(message);
  if (action != ACTION_NONE) {
    // Reset our static variable to zero
    x = 0;
    frame = 0;
    watch.fillScreen(0);
    // If we got here either through someone holding left/right or
    // the watch woke up here
    if (action >= ACTION_HOLD_LEFT)
    {
      // Set the depth and plex
      uint8_t depth = 4, plex = LED_PLEX_2;
      // Reconfigure display if needed
      if ((watch.getDepth() != depth) || (watch.getPlex() != plex))
        fps = watch.setDisplayMode(depth, plex, true);
    }
    // Reset sleep timeout on ANY button action
    watch.setTimeout(messageBits * 9);
  }
  watch.fillScreen(0);
  bool marquee[16][8];
  bool letter[8];
  int counter = 0;
  int shifterMax = ((int)(x / 8));
  if (shifterMax < messageLen) {
    shifterMax++;
  }
  for (int i = ((int)(x / 8)); i <= shifterMax; i++) {
    for (int j = 0; j < 8; j++) {
      int index = ((int)message[i]) - 48;
      if (index < 0) {
        index = 16;
      }
      convertCharToBool(pgm_read_word(&letters[index][j]), letter);
      for (int k = 0; k < 8; k++) {
        marquee[counter + k][j] = letter[7 - k];
      }
    }
    counter = counter + 8;
  }
  for (int i = 0; i < 8; i++) {
    for (int j = 0; j < 8; j++) {
      if (marquee[i+(x%8)][j] && i+x < messageBits) {
        watch.drawPixel(i, j, 200);
      }
    }
  }  
  if (frame >= 6) {
    if (x < messageBits) {
      x++;
    }
    frame = 0;
  } else {
    frame++;
  }
}


